## boards/shields/custom/Kconfig.shield
```kconfig
config SHIELD_CUSTOM_LEFT
    def_bool $(shields_list_contains,custom_left)

config SHIELD_CUSTOM_RIGHT
    def_bool $(shields_list_contains,custom_right)
```
