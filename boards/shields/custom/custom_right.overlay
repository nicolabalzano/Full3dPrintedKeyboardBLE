/ {
    kscan0: kscan {
        compatible = "zmk,kscan-gpio-matrix";
        label = "KSCAN";
        diode-direction = "col2row";
        row-gpios = <&gpio1 15 GPIO_ACTIVE_LOW
            , &gpio0 2 GPIO_ACTIVE_LOW
            , &gpio0 29 GPIO_ACTIVE_LOW
            , &gpio0 31 GPIO_ACTIVE_LOW>;
        col-gpios = <&gpio0 22 GPIO_ACTIVE_LOW
            , &gpio0 24 GPIO_ACTIVE_LOW
            , &gpio1 0 GPIO_ACTIVE_LOW
            , &gpio0 11 GPIO_ACTIVE_LOW
            , &gpio1 4 GPIO_ACTIVE_LOW
            , &gpio1 6 GPIO_ACTIVE_LOW>;
    };

    right_encoder: encoder {
        compatible = "alps,ec11";
        label = "RIGHT_ENCODER";
        a-gpios = <&gpio0 6 GPIO_ACTIVE_LOW>;
        b-gpios = <&gpio0 8 GPIO_ACTIVE_LOW>;
        resolution = <4>;
        status = "okay";
    };

    sensors {
        compatible = "zmk,keymap-sensors";
        sensors = <&right_encoder>;
    };
};
